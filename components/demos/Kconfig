## components/demos/Kconfig
```kconfig
menu "FreeRTOS Demo Selector"

    choice DEMO_SELECT
        prompt "Select which demo to run"
        default DEMO_01

        config DEMO_01
            bool "DEMO 1: Scheduler basics (task states)"

        config DEMO_02
            bool "DEMO 2: Starvation & timeslice"

        config DEMO_03
            bool "DEMO 3: vTaskDelayUntil periodic task"

        config DEMO_04
            bool "DEMO 4: Queue pipeline (sample->upload)"

        config DEMO_05
            bool "DEMO 5: Task Notification"

        config DEMO_06
            bool "DEMO 6: EventGroup gate (WIFI/MQTT mock)"

        config DEMO_07
            bool "DEMO 7: Priority inversion & inheritance (mutex)"

        config DEMO_08
            bool "DEMO 8: Software timer"

        config DEMO_09
            bool "DEMO 9: Diagnostics (task list/runtime)"

    endchoice

endmenu
```

## sdkconfig.defaults
```kconfig
# 更利于观察调度与诊断输出的一些默认配置（可按需调整）
CONFIG_FREERTOS_USE_TRACE_FACILITY=y
CONFIG_FREERTOS_GENERATE_RUN_TIME_STATS=y
CONFIG_FREERTOS_RUN_TIME_STATS_USING_ESP_TIMER=y
CONFIG_FREERTOS_CHECK_STACKOVERFLOW_CANARY=y
CONFIG_COMPILER_OPTIMIZATION_PERF=y
CONFIG_LOG_DEFAULT_LEVEL_INFO=y
```
